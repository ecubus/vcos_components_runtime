AUTOSAR XML (schema 00046)
package /AUTOSAR/EcucDefs
  module definition Rte [0..1]: post-build-variant-support=true, variants post-build/pre-compile  # Configuration of the Rte (Runtime Environment) module. / 概述：Rte（Runtime Environment）是AUTOSAR软件架构中的一个核心组件，负责在应用软件组件（SW-Cs）和底层基础软件之间提供通信和操作的接口。 注意：Rte配置需要遵循AUTOSAR CP 4.4标准中对于通信机制、事件处理和数据交换的规定；配置时需考虑系统的实时性和资源限制；在多核或分布式系统中，需特别注意跨核或网络通信的配置和优化。
    container RteBswGeneral  # General configuration parameters of the Bsw Scheduler section. / 概述：RteBswGeneral配置项用于定义AUTOSAR RTE与基础软件模块（BSW）之间的通用配置参数，这些参数控制RTE与BSW交互的行为和性能。 注意：在配置RteBswGeneral时，需要确保参数设置与系统需求相匹配，避免性能瓶颈；此配置项在AUTOSAR CP 4.4标准中应保持与BSW模块的兼容性；特别注意版本控制，确保RTE与BSW模块版本兼容。
    container RteBswModuleInstance [0..*]  # Represents one instance of a Bsw-Module configured on one ECU. / 概述：RteBswModuleInstance用于定义Bsw模块实例，它指定了基础软件模块实例的配置，包括其名称和相关属性，以便在运行时环境中进行管理和调度。 注意：在配置RteBswModuleInstance时，确保模块实例名称的唯一性，避免与其他Bsw模块实例名称冲突；此配置项在AUTOSAR CP 4.4中应与BswM配置紧密协作，确保模块间的依赖关系得到正确处理；在多模块系统中，合理规划每个模块实例的资源和优先级，以保证系统的稳定性和性能。
      foreign reference RteBswImplementationRef [0..1]: set at pre-compile, destination-type=BSW-IMPLEMENTATION  # Reference to the BswImplementation for which the Rte /SchM is configured. / 概述：RteBswImplementationRef 配置项用于将软件组件中的某个可执行实体（Runnable）与基础软件模块的实现关联起来，确保软件组件能够正确调用底层的基础软件服务。 注意：在配置时需确保引用的基础软件模块实现是存在且可用的；应当遵循AUTOSAR CP 4.4标准中对于模块间调用的规范；在多个软件组件共享同一基础软件服务时，需要特别注意调用的一致性和同步问题。
      foreign reference RteBswModuleConfigurationRef [0..1]: multiplicity set at pre-compile, set at pre-compile, destination-type=ECUC-MODULE-CONFIGURATION-VALUES  # Reference to the ECU Configuration Values provided for this BswImplementation. / 概述：RteBswModuleConfigurationRef用于指定RTE与BSW模块之间的配置关系，确保RTE能够正确引用到BSW模块的配置参数。 注意：在配置时需确保引用的BSW模块配置是存在且正确的；该引用对于实现RTE与BSW模块间的接口调用至关重要；在AUTOSAR CP 4.4标准中，对于RteBswModuleConfigurationRef的使用和配置应严格遵循规范要求。
      container RteBswEventToTaskMapping [0..*]  # Maps a BswModuleEntity onto an OsTask based on the activating BswEvent. A BswModuleEntity can be activated by more than one BswEvent and thus be mapped to more than one OsTask. In the case of a BswSchedulableEntity executed via a direct function call this RteBswEventToTaskMapping is still specified but no RteBswMappedToTaskRef element is included. The RteBswPositionInTask parameter is necessary to provide an ordering of events invoked by the same RTE API. / 概述：RteBswEventToTaskMapping 用于映射基础软件（Bsw）模块产生的事件到自动代码生成的任务，确保当事件发生时，相应的任务能够被调度执行。 注意：在配置时需确保事件与任务的映射关系准确无误，避免事件触发时任务调度失败；此配置项对于实现事件驱动的Bsw模块至关重要，需谨慎处理；AUTOSAR CP 4.4标准中对于事件到任务的映射提供了详细的规范，需要遵循这些规范以保证系统的可靠性。
        float RteBswActivationOffset [0..1]: 0..Inf, multiplicity set at pre-compile, set at pre-compile  # Activation offset in milliseconds. / 概述：RteBswActivationOffset配置项用于定义基础软件模块（BswModule）激活点相对于周期任务开始的时间偏移量，以确保基础软件模块在适当的时间被激活。 注意：该配置项的设置应考虑系统的实时性要求和任务调度策略；在配置时需确保偏移量不会导致任务执行超出其分配的时间帧；对于使用固定周期调度的系统，需特别注意偏移量设置以避免任务间的时间冲突。
        integer RteBswPositionInTask [0..1]: 0..65535, multiplicity set at pre-compile, set at pre-compile  # Each BswSchedulableEntity activation mapped to an OsTask has a specific position within the task execution. / 概述：RteBswPositionInTask 配置项用于指定基础软件模块（BswModule）中的可调度实体（SchedulableEntity）在其所属任务中的执行顺序。 注意：在配置时需确保每个任务中的RteBswPositionInTask值是唯一的，以防止执行顺序的冲突；此配置项对于系统的实时性和调度逻辑至关重要，因此应谨慎设置；在AUTOSAR CP 4.4标准中，如果该属性的使用与标准定义不一致，需要检查并调整以符合标准要求。 | For periodic activation this is the order of execution. For event driver activation this is the order of evaluation which actual BswSchedulableEntity has to be executed. In case of direct function calls this parameter is necessary to provide an ordering of events when several ExecutableEntities are invoked by the same RTE API.
        foreign reference RteBswEventRef [1..*]: set at pre-compile, destination-type=BSW-EVENT  # Reference to the BswEvent. / 概述：RteBswEventRef 配置项用于将软件组件中的某个Runnable映射到基础软件模块的事件上，这样当该事件发生时，可以触发对应的Runnable执行。 注意：在配置RteBswEventRef时，需要确保引用的事件与Runnable的触发条件相匹配；此外，应当注意事件的触发频率与Runnable的执行时间，以避免系统过载；AUTOSAR CP 4.4标准中对于事件的定义和使用可能有特定的限制和规则，需要根据标准文档进行准确配置。
        reference RteBswMappedToTaskRef [0..1]: multiplicity set at pre-compile, set at pre-compile, destination=OsTask  # Reference to the OsTask the BswSchedulableEntity activated by the RteBswEventRef is mapped to. / 概述：RteBswMappedToTaskRef 配置项用于将基础软件模块（BswModule）的调度实体映射到操作系统任务，确保基础软件组件的调度实体能够被正确调度执行。 注意：在配置时需确保映射关系的正确性，避免将一个调度实体错误地映射到多个任务；此配置项对于系统的调度策略和资源管理至关重要，应谨慎处理；在AUTOSAR CP 4.4标准中，应遵循标准定义的映射规则和约束，以保证系统的兼容性和可靠性。 | If no reference to the OsTask is specified the BswSchedulableEntity activated by this BswEvent is executed in the context of the caller.
        reference RteBswUsedOsAlarmRef [0..1]: multiplicity set at pre-compile, set at pre-compile, destination=OsAlarm  # If an OsAlarm is used to activate the OsTask this BswEvent is mapped to it shall be referenced here. / 概述：RteBswUsedOsAlarmRef 配置项用于指定BswM模块中的定时管理逻辑所使用的OS Alarm引用，这样可以确保BswM能够基于操作系统的定时机制来执行其定时任务。 注意：在配置RteBswUsedOsAlarmRef时，需要确保引用的OS Alarm已经在操作系统配置中定义；此外，该引用的正确性对于BswM模块的定时行为至关重要；在AUTOSAR CP 4.4标准中，应保证该配置项与操作系统模块的Alarm配置相匹配。
        reference RteBswUsedOsEventRef [0..1]: multiplicity set at pre-compile, set at pre-compile, destination=OsEvent  # If an OsEvent is used to activate the OsTask this BswEvent is mapped to it shall be referenced here. / 概述：RteBswUsedOsEventRef用于引用操作系统(OS)中定义的事件，这允许基础软件组件(BSW)通过运行时环境(RTE)与操作系统(OS)的事件进行交互。 注意：确保引用的OS事件在操作系统配置中已定义；在多核系统中，注意事件的核间同步问题；该配置项的使用应遵循AUTOSAR OS模块的配置规范，以保证系统的实时性和可靠性。
        uri reference RteRipsFillRoutineRef [0..*]: multiplicity set at pre-compile, requires-index=true, set at pre-compile, destination-uri=RteRipsPluginFillFlushRoutine  # Reference to a Buffer-Fill Routine implemented by an RTE Implementation Plug-In. Tags: atp.Status=draft | This routine gets invoked directly before the ExecutableEntity is started.
        uri reference RteRipsFlushRoutineRef [0..*]: multiplicity set at pre-compile, requires-index=true, set at pre-compile, destination-uri=RteRipsPluginFillFlushRoutine  # Reference to a Buffer-Flush Routine implemented by an RTE Implementation Plug-In. Tags: atp.Status=draft | This routine gets invoked directly after the ExecutableEntity has terminated.
      container RteBswExclusiveAreaImpl [0..*]  # Represents one ExclusiveArea of one BswImplementation. Used to specify the implementation means of this ExclusiveArea. / 概述：RteBswExclusiveAreaImpl配置项用于定义基础软件模块中的独占区域的实现方式，确保在多任务或中断环境中对共享资源的访问是互斥的。 注意：在配置独占区域时，需要确保选择的实现机制与系统中断和任务调度策略兼容；如果使用操作系统提供的资源管理机制，应确保其配置与操作系统的其他配置一致；在多核环境中，还需考虑跨核资源共享的问题。
        enumeration RteExclusiveAreaImplMechanism: {ALL_INTERRUPT_BLOCKING, NONE, OS_INTERRUPT_BLOCKING, OS_RESOURCE, OS_SPINLOCK, RTE_PLUGIN}, set at pre-compile  # To be used implementation mechanism for the specified ExclusiveArea.
        foreign reference RteBswExclusiveAreaRef: set at pre-compile, destination-type=EXCLUSIVE-AREA  # Reference to the ExclusiveArea for which the implementation mechanism shall be specified. / 概述：RteBswExclusiveAreaRef用于指定Bsw模块中的独占区域引用，确保在执行特定的Bsw模块代码段时，可以防止数据竞争和访问冲突。 注意：在配置时需确保引用的独占区域已在系统中定义；正确配置独占区域对于系统的实时性和稳定性至关重要；AUTOSAR CP 4.4标准中对独占区域的使用和配置有明确规范，需遵循标准以保证兼容性。
        reference RteBswExclusiveAreaOsResourceRef [0..1]: multiplicity set at pre-compile, set at pre-compile, destination=OsResource  # Optional reference to an OsResource in case RteExclusiveAreaImplMechanism is configured to OS_RESOURCE for this ExclusiveArea. / 概述：RteBswExclusiveAreaOsResourceRef 配置项用于将AUTOSAR RTE生成的独占区域（Exclusive Area）映射到操作系统（OS）层的资源（Resource），以便在多任务环境中同步对共享资源的访问。 注意：在配置时需确保独占区域与正确的OS资源关联，以保证数据一致性和避免死锁；AUTOSAR CP 4.4标准要求OS资源必须预先定义在OS配置中；在多核系统中，还需考虑资源在不同核心间的共享策略。
        reference RteBswExclusiveAreaOsSpinlockRef [0..1]: multiplicity set at pre-compile, set at pre-compile, destination=OsSpinlock  # Optional reference to an OsSpinlock in case RteExclusiveAreaImplMechanism is configured to OS_SPINLOCK for this ExclusiveArea. / 概述：RteBswExclusiveAreaOsSpinlockRef配置项用于定义Bsw模块中的独占区域与操作系统旋转锁（OsSpinlock）之间的关联，确保在多核环境下对共享资源的访问是互斥的。 注意：在配置时需确保引用的OsSpinlock已在系统中定义且适用于目标独占区域；对于不支持旋转锁的操作系统版本，此配置项不应使用；正确配置此项有助于提高多核系统的数据一致性和性能。
    container RteGeneration  # This container holds the parameters for the configuration of the RTE Generation. / 概述：RteGeneration配置项涉及AUTOSAR Runtime Environment (RTE) 代码生成的参数和选项，用于控制RTE层的代码生成过程，以符合特定的应用需求和优化目标。 注意：在配置RteGeneration时，需要确保选择的参数与系统设计和优化目标一致；不同的配置可能会影响系统性能和内存使用；应遵循AUTOSAR CP 4.4标准中对RteGeneration参数的规定和限制。
      boolean RteSystemSignalCompuMethodEnabled: set at pre-compile, default-value=false  # Generate System Signal Compute Methods by RTE. / 概述：RteSystemSignalCompuMethodEnabled配置项用于启用或禁用系统信号的计算方法，这影响信号的解释和处理方式，确保数据的正确转换和表达。 注意：在AUTOSAR CP 4.4标准中，对于系统信号的计算方法的启用或禁用应当谨慎处理，以保证系统的兼容性和数据的准确性；此配置项的使用应结合具体的应用场景和系统需求来决定；不正确的配置可能导致数据解释错误，影响系统功能的实现。 | * true: CompuMethodGen is enable. * false: CompuMethodGen is disabled.
      boolean RteIsrSimplification: set at pre-compile, default-value=false  # Simplification on ISR API used by RTE. / 概述：RteIsrSimplification配置项用于RTE使用简化后的中断服务例程（ISR），通过调用简化后的ISR来提高系统的响应速度和效率。 注意：在使用RteIsrSimplification时，需要确保系统的实时性需求得到满足；只有特权OsApplication的SWC实例才可以使用简化的ISR。 | * true: simplification is enabled. * false: no simplification.
      boolean RteEaOptimization: set at pre-compile, default-value=false  # Optimization on ExclusiveArea for RTE communications. WARNING: if optimization is enabled, do NOT invoke any RTE APIs inside an ISR (e.g. CDD)! / 概述：RteEaOptimization配置项用于优化RTE数据交换过程中使用的临界区保护措施。优化主要应用在SenderReceiver通信，在部分场景下能实现无锁读写，显著提升SR通信的运行效率 注意：在使用RteEaOptimization时，需要确保优化策略不会违反数据一致性和原子性要求；优化应当在系统的整体性能评估后启用，以避免潜在的副作用。如果开启该优化，不建议用户自行在用户代码中（尤其是CDD）直接读、写任何RTE生成的内部变量，而应该全部正确地通过RTE提供的API来操作，否则会有数据一致性的风险。 | * true: optimization is enabled. * false: no optimization.
      boolean RteDevErrorDetect: set at pre-compile, default-value=false  # Switches the development error detection and notification on or off. / 概述：RteDevErrorDetect 是一个配置参数，用于启用或禁用运行时环境（RTE）的开发错误检测功能，这有助于在开发阶段识别潜在的错误和异常。 注意：在生产代码中通常禁用此功能以优化性能；开发阶段启用此功能可以帮助检测API使用错误；根据AUTOSAR CP 4.4标准，应确保此配置与系统的诊断策略一致。 | * true: detection and notification is enabled. * false: detection and notification is disabled.
      boolean RteVfbTraceEnabled: set at pre-compile, default-value=false  # The RTE generator shall globally enable VFB tracing when RteVfbTrace is set to "true". / 概述：RteVfbTraceEnabled 是一个配置项，用于启用或禁用虚拟功能总线(VFB)的跟踪功能，这有助于在软件开发和调试阶段监控和诊断组件间的通信。 注意：在生产代码中通常应禁用此功能以避免不必要的性能开销；确保在开发和测试环境中正确配置以收集所需的诊断信息；在AUTOSAR CP 4.4标准中，此配置项的使用应符合标准规定的跟踪机制。
      boolean DataMappingGenerationOptimization1To1Rport: set at pre-compile, default-value=false  # The RTE generator shall globally enable DataMapping Generation Optimization with 1:1 Rport when this is set to "true". / 概述：DataMappingGenerationOptimization1To1Rport配置选项用于优化SenderReceiver通信的ECU间通信场景下的代码，SWC中RequiredPortPrototype和Com RX信号1:1的映射关系时的优化。 注意：开启该配置项后，会根据所有周期性触发的RX信号的周期和映射Port所在Runnable的周期的对比进行优化，该配置项会增加内存消耗以提升性能。
      boolean DataMappingGenerationOptimizationNTo1Rport: set at pre-compile, default-value=false  # The RTE generator shall globally enable DataMapping Generation Optimization with N:1 Rport when this is set to "true". / 概述：DataMappingGenerationOptimizationNTo1Rport配置选项用于优化SenderReceiver通信的ECU间通信场景下的代码，SWC中Required PortPrototype和Com RX信号N:1的映射关系时的优化。 注意：开启该配置项后，会对RX N:1场景代码进行优化，该配置项会增加内存消耗以提升性能。
      boolean DataMappingGenerationOptimizationPport: set at pre-compile, default-value=false  # The RTE generator shall globally enable DataMapping Generation Optimization with all period signal-Pport when this is set to "true". / 概述：DataMappingGenerationOptimizationPport配置选项用于优化SenderReceiver通信的ECU间通信场景下的代码，SWC中Provided PortPrototype和Com TX信号的映射关系时的优化，用于开启TX方向的UpdateOnChange功能。 注意：TX UpdateOnChange功能开启后，RTE会为每一个TX数据生成一个副本用于检测是否变化。该配置项会增加内存消耗以提升性能。
      function name RteVfbTraceFunction [0..*]: multiplicity set at pre-compile, set at pre-compile  # The RTE generator shall enable VFB tracing for a given hook function when there is a #define in the RTE configuration header file for the hook function name and tracing is globally enabled. / 概述：RteVfbTraceFunction 是一个配置项，用于启用或禁用虚拟功能总线（VFB）跟踪功能，这有助于在软件开发和调试阶段监控和记录组件间的通信。 注意：在最终产品中通常应禁用此功能以避免不必要的性能开销；确保在开发和测试环境中正确配置以收集必要的调试信息；在AUTOSAR CP 4.4标准中，应检查此配置项是否与标准中定义的跟踪机制兼容。 | Example: #define Rte_WriteHook_i1_p1_a_Start This also applies to VFB trace functions with a RteVfbTraceClientPrefix, e.g. Rte_Dbg_WriteHook_I1_P1_a_Start.
    container RteSwComponentInstance [0..*]  # Representation of one SwComponentPrototype located on the to be configured ECU. All subcontainer configuration aspects are in relation to this SwComponentPrototype. / 概述：RteSwComponentInstance配置项定义了软件组件实例在系统中的存在，包括其实例化的组件类型和分配给该实例的资源。 注意：在配置RteSwComponentInstance时，确保每个实例的标识符唯一，以避免在系统中的冲突；组件实例化应遵循AUTOSAR CP 4.4中定义的软件组件模型，确保兼容性和一致性；分配资源时考虑实际硬件限制和性能需求，以保证系统的高效运行。 | The RteSwComponentInstance can be associated with either a AtomicSwComponentType or ParameterSwComponentType.
      foreign reference RteSoftwareComponentInstanceRef [0..1]: multiplicity set at pre-compile, set at pre-compile, destination-type=SW-COMPONENT-PROTOTYPE  # Reference to a SwComponentPrototype. / 概述：RteSoftwareComponentInstanceRef用于标识AUTOSAR软件组件实例的引用，确保系统中的组件能够被正确识别和配置。 注意：在配置时需确保引用的软件组件实例在系统中是唯一的；引用应与实际软件组件的定义严格匹配，避免引用错误；在多组件系统中，正确的组件实例引用对于组件间通信至关重要。
      container RteEventToTaskMapping [0..*]  # Maps an instance of a RunnableEntity onto one OsTask based on the activating RTEEvent. / 概述：RteEventToTaskMapping 配置项用于将特定的事件映射到操作系统任务，这样当事件发生时，相应的任务可以被激活以执行相关的运行实体（Runnable）。 注意：在配置时需确保事件与任务之间的映射关系正确无误，以免影响系统的响应性和实时性；此外，应避免一个事件映射到多个任务，以防止资源竞争和调度问题；在多核环境下，还需考虑事件与任务在不同核心间的映射关系，确保系统的并行处理能力。 | In the case of a RunnableEntity executed via a direct function call this RteEventToTaskMapping is still specified but no RteMappedToTask element is included. The RtePositionInTask parameter is necessary to provide an ordering of events invoked by the same RTE API.
        float RteActivationOffset [0..1]: 0..Inf, multiplicity set at pre-compile, set at pre-compile  # Activation offset in milliseconds. / 概述：RteActivationOffset配置项用于定义在周期性任务中，运行实体（Runnable）的启动偏移时间，以确保运行实体按照特定的时间间隔启动执行。 注意：该配置项的设置应小于其所在任务的周期时间，以避免执行时间超出任务周期；在配置时需考虑系统的实时性要求和运行实体的执行时间；对于非周期性任务，此配置项不适用。
        integer RtePositionInTask [0..1]: 0..65535, multiplicity set at pre-compile, set at pre-compile  # Each RunnableEntity mapped to an OsTask has a specific position within the task execution. / 概述：RtePositionInTask 用于定义某个运行实体（Runnable）在特定任务中的执行顺序位置，确保各Runnables按照预定顺序执行，从而满足系统的功能和时间要求。 注意：确保每个任务内的RtePositionInTask唯一，避免冲突；合理设计顺序以满足实时性要求；在多核系统中注意跨核调度和执行一致性。 | For periodic activation this is the order of execution. For event driver activation this is the order of evaluation which actual RunnableEntity has to be executed. In case of direct function calls this parameter is necessary to provide an ordering of events when several ExecutableEntities are invoked by the same RTE API.
        foreign reference RteEventRef [1..*]: set at pre-compile, destination-type=RTE-EVENT  # Reference to the description of the RTEEvent which is pointing to the RunnableEntity being mapped. This allows a fine grained mapping of RunnableEntites based on the activating RTEEvent. / 概述：RteEventRef 配置项用于指定与运行实体（Runnable）相关联的事件，这些事件触发Runnable的执行。 注意：在配置RteEventRef时，需要确保引用的事件与Runnable的触发条件相匹配；事件的类型和属性必须符合AUTOSAR CP 4.4标准；在多Runnable环境中，应避免事件配置导致的资源竞争和优先级反转问题。
        reference RteMappedToTaskRef [0..1]: multiplicity set at pre-compile, set at pre-compile, destination=OsTask  # Reference to the OsTask the RunnableEntity activated by the RteEventRef is mapped to. / 概述：RteMappedToTaskRef配置项用于将一个Runnable Entity映射到一个OS任务，这样可以指定Runnable应当在哪个OS任务的上下文中执行。 注意：在配置RteMappedToTaskRef时，需要确保Runnable与任务的映射关系符合系统设计要求，并且不违反OS的调度策略；此外，应当避免将多个高运算负载的Runnable映射到同一个任务，以防止潜在的性能瓶颈；AUTOSAR CP 4.4标准中对于Runnable到任务的映射有明确的规范，需要确保配置项的使用与标准保持一致。 | If no reference to the OsTask is specified the RunnableEntity shall be executed via a direct function call. The fact that no reference to an OsTask is specified for a RunnableEntity does not necessarily imply that every RTE generator has to support the implementation of this RunnableEntity as a direct function call. The standard set of use cases for direct function calls that has to be supported by every RTE generator is explicitly stated as requirements in this document. For further optimization RTE vendors are free to support additional scenarios of direct function call implementations that are not explicitly required in this document.
        reference RteUsedOsAlarmRef [0..1]: multiplicity set at pre-compile, set at pre-compile, destination=OsAlarm  # If an OsAlarm is used to activate the OsTask this RteEvent is mapped to it shall be referenced here. / 概述：RteUsedOsAlarmRef 配置项用于指定AUTOSAR RTE（Runtime Environment）与操作系统（OS）之间的闹钟（Alarm）引用，这使得RTE能够使用操作系统提供的定时服务。 注意：在配置RteUsedOsAlarmRef时，需要确保引用的OS Alarm已经在操作系统模块中定义；此外，闹钟的属性和行为应与RTE的定时需求相匹配；在多任务环境中，还需注意闹钟触发的任务与RTE的任务调度策略的一致性。
        reference RteUsedOsEventRef [0..1]: multiplicity set at pre-compile, set at pre-compile, destination=OsEvent  # If an OsEvent is used to activate the OsTask this RteEvent is mapped to it shall be referenced here. / 概述：RteUsedOsEventRef 配置项用于指定AUTOSAR RTE生成的代码中，某个Runnable实体或者C/S操作所使用的操作系统（OS）事件的引用。 注意：在配置RteUsedOsEventRef时，需要确保引用的OS事件已经在操作系统配置中定义；此外，该事件应当与Runnable或C/S操作的触发条件相匹配；在多任务环境中，还需注意事件与任务的关联性，确保系统的调度逻辑正确。
      container RteExclusiveAreaImplementation [0..*]  # Specifies the implementation to be used for the data consistency of this ExclusiveArea. / 概述：RteExclusiveAreaImplementation配置项用于定义AUTOSAR运行时环境（RTE）中的独占区域实现，确保在多任务或多核环境下对共享资源的访问是互斥的，从而防止数据竞争和条件竞争。 注意：在配置时需确保每个独占区域的实现方式与硬件架构兼容；对于多核系统，还需考虑跨核互斥的实现机制；AUTOSAR CP 4.4标准中对独占区域的实现提供了详细的指导，应遵循相关规范以保证系统的稳定性和性能。
        enumeration RteExclusiveAreaImplMechanism: {ALL_INTERRUPT_BLOCKING, NONE, OS_INTERRUPT_BLOCKING, OS_RESOURCE, OS_SPINLOCK, RTE_PLUGIN}, set at pre-compile  # To be used implementation mechanism for the specified ExclusiveArea. / 概述：RteExclusiveAreaImplMechanism 配置项用于指定AUTOSAR RTE（Run-Time Environment）中独占区域（Exclusive Area）的实现机制，这决定了如何在软件架构中同步对共享资源的访问。 注意：在AUTOSAR CP 4.4标准中，独占区域的实现机制可以是内部RTE机制、OS内部资源或OS中断锁定。选择合适的实现机制对于系统的性能和可靠性至关重要；配置时需确保与操作系统(OS)的支持和应用软件组件的需求相匹配；不当的配置可能导致死锁或优先级反转等并发问题。
        foreign reference RteExclusiveAreaRef: set at pre-compile, destination-type=EXCLUSIVE-AREA  # Reference to the ExclusiveArea. / 概述：RteExclusiveAreaRef 配置项用于指定一个运行实体（Runnable）或者一个内部函数可以访问的独占区域的引用，确保在并发环境中对共享资源的访问是互斥的。 注意：在配置时需确保引用的独占区域已经在系统中定义；独占区域的使用应遵循AUTOSAR的互斥机制规定；正确配置独占区域对于防止数据竞争和提高系统稳定性至关重要。
        reference RteExclusiveAreaOsResourceRef [0..1]: multiplicity set at pre-compile, set at pre-compile, destination=OsResource  # Optional reference to an OsResource in case RteExclusiveAreaImplMechanism is configured to OS_RESOURCE for this ExclusiveArea. / 概述：RteExclusiveAreaOsResourceRef用于将AUTOSAR RTE的独占区域与操作系统的资源进行关联，确保在访问共享资源时能够避免数据竞争和条件竞争。 注意：在配置时需确保所引用的OS资源已定义且与独占区域的使用目的相匹配；AUTOSAR CP 4.4标准要求明确独占区域与OS资源的关系，以保证系统的实时性和稳定性；配置不当可能导致系统性能下降或运行时错误。
package /AUTOSAR/EcucDestinationUriDefSets
  ecuc destination uri def set RteRipsUriDefSet
    ecuc destination uri def RteRipsInvocationHandler
      destination-uri-policy destination-uri-nesting-contract=TARGET-CONTAINER:
        container RteRipsInvocationHandlerFnc [0..*]  # This container describes an invocation handler function implemented by an RTE Implementation Plug-In to handle the invocation of server runnables and triggered runnables via a transformer. Tags: atp.Status=draft / 概述：RteRipsInvocationHandlerFnc是用于定义RTE生成代码中，远程过程调用（Remote Procedure Call, RPC）的处理函数，它允许不同软件组件间通过RTE进行通信。 注意：（该配置项VCOS未支持）该配置项需要确保处理函数与远程调用请求匹配，以保证通信的正确性；在配置时需注意RPC的安全性和数据一致性；AUTOSAR CP 4.4标准中未明确定义此配置项，可能属于特定实现或扩展。
          function name RteRipsInvocationHandlerFncSymbol  # C-Symbol of the Rte_Rips_FillFlushRoutine function. Tags: atp.Status=draft / 概述：RteRipsInvocationHandlerFncSymbol 是用于定义RTE生成代码中，某个RIPS（RTE Internal Positioning System）调用处理函数的符号名称，这个符号用于链接时识别对应的函数实现。 注意：（该配置项VCOS未支持）在配置时需确保符号名称的唯一性，避免链接时的符号冲突；符号名称应遵循项目的命名规范；在多组件系统中，应注意不同组件间的命名空间可能导致的冲突。
    ecuc destination uri def RteRipsPlugin
      destination-uri-policy destination-uri-nesting-contract=TARGET-CONTAINER:
        container RteRipsPluginProps  # This container defines the identity of the Rte Implementation Plug-in and provides the RTE relevant parameters of the Rte Implementation Plug-in. Tags: atp.Status=draft / 概述：RteRipsPluginProps 是一个配置项，用于定义RTE生成代码时所使用的插件属性，这些属性可能会影响代码生成的行为或者输出。 注意：（该配置项VCOS未支持）在AUTOSAR CP 4.4标准中，RteRipsPluginProps的具体属性应当与标准文档中定义的属性保持一致；如果使用了非标准的插件或属性，需要确保它们与现有系统兼容；在修改任何插件属性之前，应当理解其对系统行为的潜在影响。 | The shortName of the container defines the name of the Rte Implementation Plug-in used for the API infixes.
          boolean RtePluginSupportsIReadIWrite: default-value=false  # Denotes if or if not the plug-in supports the Rte_Rips_IRead/IWrite macros for primitive data. Tags: atp.Status=draft / 概述：RtePluginSupportsIReadIWrite配置项用于指定RTE生成代码时是否支持IRead和IWrite接口，这些接口用于简化组件间的数据读写操作。 注意：（该配置项VCOS未支持）在AUTOSAR CP 4.4标准中，对于IRead和IWrite的支持是可选的，因此开发者需要根据项目需求决定是否启用此功能；启用IRead和IWrite可能会影响生成代码的大小和性能，需谨慎考虑；确保所有相关组件都兼容这些接口的使用，以避免集成时的兼容性问题。
          enumeration RteRipsGlobalCopyInstantiationPolicy: {RTE_RIPS_INSTANTIATION_BY_PLUGIN, RTE_RIPS_INSTANTIATION_BY_RTE}, default-value=RTE_RIPS_INSTANTIATION_BY_RTE  # Globally enables or disables the support for Rte Implementation Plug-Ins (RIPS) Tags: atp.Status=draft / 概述：RteRipsGlobalCopyInstantiationPolicy 配置项用于指定RTE（Runtime Environment）中的Inter-Partition Communication (IPC) 机制，即跨分区通信时，全局变量的实例化策略。 注意：（该配置项VCOS未支持）在AUTOSAR CP 4.4标准中，需要确保跨分区通信的全局变量实例化策略与系统设计和内存分配方案相匹配；此配置项对系统的内存管理和数据一致性有重要影响；在配置时应考虑分区间通信的安全性和隔离性要求。
    ecuc destination uri def RteRipsPluginFillFlushRoutine
      destination-uri-policy destination-uri-nesting-contract=TARGET-CONTAINER:
        container RteRipsPluginFillFlushRoutineFnc [0..*]  # This container describes a Fill-Flush Routine function implemented by a RTE Implementation Plug-In to handle the buffering for implicit communication. Tags: atp.Status=draft / 概述：RteRipsPluginFillFlushRoutineFnc是一个配置项，用于指定RTE与底层硬件交互时，填充和刷新数据的插件函数。 注意：（该配置项VCOS未支持）在配置时需确保所指定的函数符合AUTOSAR CP 4.4标准中对插件函数的要求和格式；该函数通常由系统集成者提供，需要与底层硬件交互的实现细节相匹配；在多核或多分区系统中，应考虑该函数的调用对系统资源的影响，确保不会引起资源竞争或违反安全隔离原则。
          enumeration RteRipsModeDisablingHandling: {RTE_RIPS_CONSIDER_MODE_DISABLINGS, RTE_RIPS_IGNORE_MODE_DISABLINGS}  # This parameter configures whether mode disabling dependencies are considered for the invocation of Rte_Rips_FillFlushRoutines. Tags: atp.Status=draft / 概述：RteRipsModeDisablingHandling配置项用于定义AUTOSAR软件组件在其依赖的RTE模式切换被禁用时的行为，确保系统在特定模式下的稳定性和预期行为。 注意：在配置时需确保对模式切换的依赖关系和行为影响有充分理解；该��置项在AUTOSAR CP 4.4标准中可能不直接存在，需参考最新的AUTOSAR文档确认其有效性和实现方式；正确配置此项对于系统的安全性和稳定性至关重要。
          enumeration RteRipsOsSchedulePoint [0..1]: {NONE, UNCONDITIONAL}  # Introduce a schedule point by explicitly calling Os Schedule service after the execution of the Rte_Rips_FillFlushRoutine. Tags: atp.Status=draft / 概述：RteRipsOsSchedulePoint配置项用于定义AUTOSAR运行时环境（RTE）中的调度点，这些调度点是操作系统（OS）用来管理任务和中断的时间点，以优化系统的调度和响应。 注意：（该配置项VCOS未支持）在配置RteRipsOsSchedulePoint时，需要确保调度点的设置不会导致任务的过度延迟或系统资源的浪费；调度点的选择和配置应考虑系统的实时性要求和资源限制；AUTOSAR CP 4.4标准中对调度点的具体实现和配置可能有特定的要求和限制，需要仔细参考相关文档。
          function name RteRipsPluginFillFlushRoutineFncSymbol  # C-Symbol of the Rte_Rips_FillFlushRoutine function. Tags: atp.Status=draft / 概述：RteRipsPluginFillFlushRoutineFncSymbol 配置项用于指定RTE与底层硬件交互时，填充和刷新数据的插件函数符号名称，这些函数用于处理数据的传输和同步。 注意：（该配置项VCOS未支持）该配置项的值需要与实际实现的函数符号名称一致，以确保正确的函数调用；在多核或多分区系统中，确保该函数能够安全地在不同上下文中调用；如果该配置项的属性与AUTOSAR CP 4.4标准不一致，需要检查并更新以符合标准要求。
package /AUTOSAR/LifeCycleInfoSets
  life cycle info set AUTOSARParameterDefinition
    life-cycle-infos:
      lc-object=AdcGroupEcucPartitionRef, lc-state=draft
      lc-object=AdcEcucPartitionRef, lc-state=draft
      lc-object=AdcKernelEcucPartitionRef, lc-state=draft
      lc-object=ArtiConstant, lc-state=draft
      lc-object=ArtiConstantString, lc-state=draft
      lc-object=ArtiExpression, lc-state=draft
      lc-object=ArtiExpressionString, lc-state=draft
      lc-object=ArtiHook, lc-state=draft
      lc-object=ArtiHookClass, lc-state=draft
      lc-object=ArtiHookEventName, lc-state=draft
      lc-object=ArtiHookInstance, lc-state=draft
      lc-object=ArtiHookEventParameterTypeRef, lc-state=draft
      lc-object=ArtiHookInstanceParameterTypeRef, lc-state=draft
      lc-object=ArtiObjectClassParameter, lc-state=draft
      lc-object=ArtiParameterTypeMapRef, lc-state=draft
      lc-object=ArtiObjectInstanceParameter, lc-state=draft
      lc-object=ArtiConstantRef, lc-state=draft
      lc-object=ArtiExpressionRef, lc-state=draft
      lc-object=ArtiHookRef, lc-state=draft
      lc-object=ArtiParameterTypeMap, lc-state=draft
      lc-object=ArtiParameterTypeMapPair, lc-state=draft
      lc-object=ArtiParameterTypeMapPairInput, lc-state=draft
      lc-object=ArtiParameterTypeMapPairOutput, lc-state=draft
      lc-object=ArtiGenericComponentClass, lc-state=draft
      lc-object=ArtiGenericComponentClassName, lc-state=draft
      lc-object=ArtiGenericComponentClassParameter, lc-state=draft
      lc-object=ArtiGenericComponentClassParameterName, lc-state=draft
      lc-object=ArtiParameterTypeMapRef, lc-state=draft
      lc-object=ArtiGenericComponentInstance, lc-state=draft
      lc-object=ArtiGenericComponentInstanceName, lc-state=draft
      lc-object=ArtiGenericComponentClassRef, lc-state=draft
      lc-object=ArtiGenericComponentInstanceParameter, lc-state=draft
      lc-object=ArtiConstantRef, lc-state=draft
      lc-object=ArtiExpressionRef, lc-state=draft
      lc-object=ArtiGenericComponentClassParameterRef, lc-state=draft
      lc-object=ArtiHookRef, lc-state=draft
      lc-object=ArtiHwCoreClass, lc-state=draft
      lc-object=ArtiCurrentApplicationClassRef, lc-state=draft
      lc-object=ArtiCurrentTaskClassRef, lc-state=draft
      lc-object=ArtiLastErrorClassRef, lc-state=draft
      lc-object=ArtiHwCoreInstance, lc-state=draft
      lc-object=ArtiCurrentApplicationInstanceRef, lc-state=draft
      lc-object=ArtiCurrentTaskInstanceRef, lc-state=draft
      lc-object=ArtiEcucCoreRef, lc-state=draft
      lc-object=ArtiLastErrorInstanceRef, lc-state=draft
      lc-object=ArtiOsClass, lc-state=draft
      lc-object=ArtiOsAppModeClassRef, lc-state=draft
      lc-object=ArtiOsInstance, lc-state=draft
      lc-object=ArtiOsAppModeEcucRef, lc-state=draft
      lc-object=ArtiOsAppModeInstanceRef, lc-state=draft
      lc-object=ArtiOsEcucRef, lc-state=draft
      lc-object=ArtiOsTaskHookRef, lc-state=draft
      lc-object=ArtiOsTaskClass, lc-state=draft
      lc-object=ArtiOsTaskInstance, lc-state=draft
      lc-object=ArtiGenericComponentInstanceRef, lc-state=draft
      lc-object=ArtiOsTaskEcucRef, lc-state=draft
      lc-object=CanControllerEcucPartitionRef, lc-state=draft
      lc-object=CanTTControllerEcucPartitionRef, lc-state=draft
      lc-object=CanEcucPartitionRef, lc-state=draft
      lc-object=CanTSynGlobalTimeSecureTmacLength, lc-state=draft
      lc-object=CanTSynTxTmacCalculated, lc-state=draft
      lc-object=CanTSynGlobalTimeMinMsgGap, lc-state=draft
      lc-object=CanTSynRxTmacValidated, lc-state=draft
      lc-object=CanTrcvChannelEcucPartitionRef, lc-state=draft
      lc-object=CanTrcvEcucPartitionRef, lc-state=draft
      lc-object=CorTstBackgroundEcucPartitionRef, lc-state=draft
      lc-object=CorTstForegroundEcucPartitionRef, lc-state=draft
      lc-object=CorTstEcucPartitionRef, lc-state=draft
      lc-object=CryptoDriverObjectEcucPartitionRef, lc-state=draft
      lc-object=CryptoEcucPartitionRef, lc-state=draft
      lc-object=DemFreezeFrameRecordTrigger, lc-state=draft
      lc-object=DioPortEcucPartitionRef, lc-state=draft
      lc-object=DioChannelEcucPartitionRef, lc-state=draft
      lc-object=DioChannelGroupEcucPartitionRef, lc-state=draft
      lc-object=DioEcucPartitionRef, lc-state=draft
      lc-object=EepEcucPartitionRef, lc-state=draft
      lc-object=EthCtrlEcucPartitionRef, lc-state=draft
      lc-object=EthEcucPartitionRef, lc-state=draft
      lc-object=EthSwtConfigEcucPartitionRef, lc-state=draft
      lc-object=EthSwtEcucPartitionRef, lc-state=draft
      lc-object=EthTSynGlobalTimeSecureTmacLength, lc-state=draft
      lc-object=EthTSynGlobalTimeMinMsgGap, lc-state=draft
      lc-object=EthTSynTxTmacCalculated, lc-state=draft
      lc-object=EthTSynRxTmacValidated, lc-state=draft
      lc-object=EthTrcvConfigEcucPartitionRef, lc-state=draft
      lc-object=EthTrcvEcucPartitionRef, lc-state=draft
      lc-object=FlsEcucPartitionRef, lc-state=draft
      lc-object=FlsTstEcucPartitionRef, lc-state=draft
      lc-object=FrEcucPartitionRef, lc-state=draft
      lc-object=FrCtrlEcucPartitionRef, lc-state=draft
      lc-object=FrTSynGlobalTimeSecureTmacLength, lc-state=draft
      lc-object=FrTSynUseExtendedMsgFormat, lc-state=draft
      lc-object=FrTSynTxTmacCalculated, lc-state=draft
      lc-object=FrTSynGlobalTimeMinMsgGap, lc-state=draft
      lc-object=FrTSynGlobalTimeTmacTimeout, lc-state=draft
      lc-object=FrTSynRxTmacValidated, lc-state=draft
      lc-object=FrTrcvChannelEcucPartitionRef, lc-state=draft
      lc-object=FrTrcvEcucPartitionRef, lc-state=draft
      lc-object=GptChannelEcucPartitionRef, lc-state=draft
      lc-object=GptEcucPartitionRef, lc-state=draft
      lc-object=GptKernelEcucPartitionRef, lc-state=draft
      lc-object=IcuChannelEcucPartitionRef, lc-state=draft
      lc-object=IcuEcucPartitionRef, lc-state=draft
      lc-object=IcuKernelEcucPartitionRef, lc-state=draft
      lc-object=IpduMContainedPduOffset, lc-state=draft
      lc-object=IpduMPduUpdateBitPosition, lc-state=draft
      lc-object=IpduMContainedPduOffset, lc-state=draft
      lc-object=IpduMPduUpdateBitPosition, lc-state=draft
      lc-object=IPDUM_HEADERTYPE_NONE, lc-state=draft
      lc-object=IPDUM_HEADERTYPE_NONE, lc-state=draft
      lc-object=IpduMUnusedAreasDefault, lc-state=draft
      lc-object=LinEcucPartitionRef, lc-state=draft
      lc-object=LinChannelEcucPartitionRef, lc-state=draft
      lc-object=LinTrcvChannelEcucPartitionRef, lc-state=draft
      lc-object=LinTrcvEcucPartitionRef, lc-state=draft
      lc-object=McuEcucPartitionRef, lc-state=draft
      lc-object=OcuChannelEcucPartitionRef, lc-state=draft
      lc-object=OcuEcucPartitionRef, lc-state=draft
      lc-object=OcuKernelEcucPartitionRef, lc-state=draft
      lc-object=PortPinEcucPartitionRef, lc-state=draft
      lc-object=PortEcucPartitionRef, lc-state=draft
      lc-object=PwmChannelEcucPartitionRef, lc-state=draft
      lc-object=PwmEcucPartitionRef, lc-state=draft
      lc-object=PwmKernelEcucPartitionRef, lc-state=draft
      lc-object=RamTstEcucPartitionRef, lc-state=draft
      lc-object=RamTstBlockParamsEcucPartitionRef, lc-state=draft
      lc-object=RteRipsFillRoutineRef, lc-state=draft
      lc-object=RteRipsFlushRoutineRef, lc-state=draft
      lc-object=RteBswExclusiveAreaResponsibleRipsPluginRef, lc-state=draft
      lc-object=RteModeMachineInstanceResponsibleRipsPluginRef, lc-state=draft
      lc-object=RteDSMQResponsibleRipsPluginRef, lc-state=draft
      lc-object=RteRips, lc-state=draft
      lc-object=RteRipsSupport, lc-state=draft
      lc-object=RteRipsPluginConfigurationRef, lc-state=draft
      lc-object=RteRipsFillRoutineRef, lc-state=draft
      lc-object=RteRipsFlushRoutineRef, lc-state=draft
      lc-object=RteRipsInvocationHandlerRef, lc-state=draft
      lc-object=RteExclusiveAreaResponsibleRipsPluginRef, lc-state=draft
      lc-object=RteModeMachineInstanceResponsibleRipsPluginRef, lc-state=draft
      lc-object=SoAdSocketTcpTlsConnectionRef, lc-state=draft
      lc-object=SpiDeviceEcucPartitionRef, lc-state=draft
      lc-object=SpiEcucPartitionRef, lc-state=draft
      lc-object=SpiKernelEcucPartitionRef, lc-state=draft
      lc-object=TcpIpTlsConfig, lc-state=draft
      lc-object=TcpIpTlsMaxConnections, lc-state=draft
      lc-object=TcpIpTlsCsmRandomGenerateJobRef, lc-state=draft
      lc-object=TcpIpTlsCiphersuites, lc-state=draft
      lc-object=TcpIpTlsCertificateIdentity, lc-state=draft
      lc-object=TcpIpTlsServerNameIdentification, lc-state=draft
      lc-object=TcpIpTlsCiphersuiteDefinition, lc-state=draft
      lc-object=TcpIpTlsCiphersuiteId, lc-state=draft
      lc-object=TcpIpTlsCiphersuiteName, lc-state=draft
      lc-object=TcpIpTlsCiphersuitePriority, lc-state=draft
      lc-object=TcpIpTlsUseAEADCipher, lc-state=draft
      lc-object=TcpIpTlsUsePresharedKeys, lc-state=draft
      lc-object=TcpIpTlsUseSecurityExtensionForceMacThenHash, lc-state=draft
      lc-object=TcpIpTlsVersion, lc-state=draft
      lc-object=TcpIpTlsCiphersuiteWorker, lc-state=draft
      lc-object=TcpIpTlsCipherAEADCipherKeyLength, lc-state=draft
      lc-object=TcpIpTlsCipherEncryptKeyLength, lc-state=draft
      lc-object=TcpIpTlsCipherMacKeyLength, lc-state=draft
      lc-object=TcpIpTlsCipherCsmDecryptJobRef, lc-state=draft
      lc-object=TcpIpTlsCipherCsmDecryptKeyRef, lc-state=draft
      lc-object=TcpIpTlsCipherCsmEncryptJobRef, lc-state=draft
      lc-object=TcpIpTlsCipherCsmEncryptKeyRef, lc-state=draft
      lc-object=TcpIpTlsCipherCsmMacGenerateJobRef, lc-state=draft
      lc-object=TcpIpTlsCipherCsmMacGenerateKeyRef, lc-state=draft
      lc-object=TcpIpTlsCipherCsmMacVerifyJobRef, lc-state=draft
      lc-object=TcpIpTlsCipherCsmMacVerifyKeyRef, lc-state=draft
      lc-object=TcpIpTlsCiphersuiteDefinitionRef, lc-state=draft
      lc-object=TcpIpTlsConnectionHandshakeRef, lc-state=draft
      lc-object=TcpIpTlsHandshake, lc-state=draft
      lc-object=TcpIpTlsCsmPRFSupportType, lc-state=draft
      lc-object=TcpIpTlsCsmHashVerifyJobRef, lc-state=draft
      lc-object=TcpIpTlsCsmKeyExchangeCalcPubValJobRef, lc-state=draft
      lc-object=TcpIpTlsCsmKeyExchangeCalcSecretJobRef, lc-state=draft
      lc-object=TcpIpTlsCsmKeyExchangeDecryptJobRef, lc-state=draft
      lc-object=TcpIpTlsCsmKeyExchangeDecryptKeyRef, lc-state=draft
      lc-object=TcpIpTlsCsmKeyExchangeEncryptJobRef, lc-state=draft
      lc-object=TcpIpTlsCsmKeyExchangeEncryptKeyRef, lc-state=draft
      lc-object=TcpIpTlsCsmKeyExchangeKeyRef, lc-state=draft
      lc-object=TcpIpTlsCsmKeyExchangeSignatureGenerateJobRef, lc-state=draft
      lc-object=TcpIpTlsCsmKeyExchangeSignatureGenerateKeyRef, lc-state=draft
      lc-object=TcpIpTlsCsmKeyExchangeSignatureVerifyJobRef, lc-state=draft
      lc-object=TcpIpTlsCsmKeyExchangeSignatureVerifyKeyRef, lc-state=draft
      lc-object=TcpIpTlsCsmMasterSecretKeyRef, lc-state=draft
      lc-object=TcpIpTlsCsmPrfMacJobRef, lc-state=draft
      lc-object=TcpIpTlsCsmPrfMacKeyRef, lc-state=draft
      lc-object=TcpIpTlsPskIdentity, lc-state=draft
      lc-object=TcpIpTlsPresharedKeyIdentity, lc-state=draft
      lc-object=TcpIpTlsPresharedKeyIdentityHint, lc-state=draft
      lc-object=TcpIpTlsPskGetClientKeyIdentityFunc, lc-state=draft
      lc-object=TcpIpTlsPskGetKeyIdentyHintFunc, lc-state=draft
      lc-object=TcpIpTlsPskGetServerKeyIdentityFunc, lc-state=draft
      lc-object=TcpIpTlsPresharedKeyCsmKeyRef, lc-state=draft
      lc-object=TcpIpTlsConnection, lc-state=draft
      lc-object=TcpIpTlsConnectionGetTimeFunc, lc-state=draft
      lc-object=TcpIpTlsConnectionId, lc-state=draft
      lc-object=TcpIpTlsConnectionType, lc-state=draft
      lc-object=TcpIpTlsMaxFragmentLength, lc-state=draft
      lc-object=TcpIpTlsPortAssignment, lc-state=draft
      lc-object=TcpIpTlsUseClientAuthenticationRequest, lc-state=draft
      lc-object=TcpIpTlsUseSecurityExtensionRecordSizeLimit, lc-state=draft
      lc-object=TcpIpTlsCertificateIdentityRef, lc-state=draft
      lc-object=TcpIpTlsConnectionCiphersuiteWorkerRef, lc-state=draft
      lc-object=TcpIpTlsConnectionGroupRef, lc-state=draft
      lc-object=TcpIpTlsConnectionPskIdentityRef, lc-state=draft
      lc-object=TcpIpTlsIpAddressAssignment, lc-state=draft
      lc-object=TcpIpTlsConnectionGroup, lc-state=draft
      lc-object=WEthCtrlEcucPartitionRef, lc-state=draft
      lc-object=WEthEcucPartitionRef, lc-state=draft
      lc-object=WEthTrcvConfigEcucPartitionRef, lc-state=draft
      lc-object=WEthTrcvEcucPartitionRef, lc-state=draft
      lc-object=WdgEcucPartitionRef, lc-state=draft
