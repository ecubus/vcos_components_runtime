AUTOSAR XML (schema 00046)
package /ActiveEcuC
  module config Rte: implementation-config-variant=VARIANT-PRE-COMPILE, module-description=Rte_Impl
    RteGeneration: RteDevErrorDetect=false, RteVfbTraceEnabled=false, RteVfbTraceFunction=(unset)
    RteBswGeneral
