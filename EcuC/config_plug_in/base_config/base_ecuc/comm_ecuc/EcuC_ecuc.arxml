AUTOSAR XML (schema 00046)
package /ActiveEcuC
  module config EcuC: implementation-config-variant=VARIANT-PRE-COMPILE, module-description=Com_Impl
    EcucConfigSet
      EcucPduCollection: PduIdTypeEnum=UINT8, PduLengthTypeEnum=UINT8
        MetaDataType
          MetaDataItem: MetaDataItemLength=1, MetaDataItemType=CAN_ID_32
    EcucHardware
    EcucPartitionCollection
      EcucPartition:
        EcucPartitionBswModuleExecution = false
        EcucPartitionQmBswModuleExecution = true
        PartitionCanBeRestarted = false
        EcucPartitionSoftwareComponentInstanceRef = (unset)
        EcucPartitionBswModuleDistinguishedPartition = 
